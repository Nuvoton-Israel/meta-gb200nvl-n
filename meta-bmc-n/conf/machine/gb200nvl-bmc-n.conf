## meta-bmc-n/conf/machine/gb200nvl-bmc-n.conf
```bitbake
KMACHINE = "nuvoton"
KERNEL_DEVICETREE = "nuvoton/npcm-bmc-nvidia-gb200nvl-bmc.dtb"

UBOOT_MACHINE = "arbel_evb_defconfig"
UBOOT_DEVICETREE = "nuvoton-npcm845-evb"

IGPS_MACHINE = "EB"
DEVICE_GEN = "A1"

require conf/machine/include/npcm8xx.inc

# Manipulate the DISTRO_NAME variable string for our needs
DISTRO_NAME:remove = "Phosphor"
DISTRO_NAME:remove = "OpenBMC"
DISTRO_NAME:remove = "(Phosphor"
DISTRO_NAME:prepend = "NVIDIA Host BMC (OpenBMC "


UBOOT_MKIMAGE:append:npcm8xx = " -E -B 8"
SECURED_IMAGE = "True"
TIP_IMAGE = "True"

FLASH_SIZE = "65536"
FLASH_UBOOT_OFFSET:flash-65536 = "0"
FLASH_MANIFEST_OFFSET:flash-65536 = "3832"
FLASH_UBOOT_ENV_OFFSET:flash-65536 = "3840"
FLASH_KERNEL_OFFSET:flash-65536 = "4096"
FLASH_ROFS_OFFSET:flash-65536 = "12288"
FLASH_RWFS_OFFSET:flash-65536 = "65536"

SERIAL_CONSOLES = "115200;ttyS0"

VIRTUAL-RUNTIME_obmc-inventory-manager = "entity-manager"
#VIRTUAL-RUNTIME_obmc-inventory-manager = "nvidia-gpumgr"
PREFERRED_PROVIDER_virtual/obmc-inventory-data = "entity-manager"
#PREFERRED_PROVIDER_virtual/obmc-inventory-data = "nvidia-gpumgr"
PREFERRED_PROVIDER_virtual/phosphor-led-manager-config-native = "led-manager-config-native"
PREFERRED_PROVIDER_virtual/obmc-host-ipmi-hw = "phosphor-ipmi-ssif"

# Install Kernel modules
MACHINE_EXTRA_RRECOMMENDS = "kernel-modules"

# Remove default OpenBMC features we don't need
DISTRO_FEATURES:remove = "avahi"
DISTRO_FEATURES:remove = "otp-provisioning"
IMAGE_FEATURES:remove = "obmc-phosphor-power"
IMAGE_FEATURES:remove = "phosphor-snmp"

IMAGE_INSTALL:append = " mmc-utils systemd-analyze usbutils"

# this is needed by emmc, avoid removing it.
BAD_RECOMMENDATIONS:remove = "e2fsprogs-e2fsck"

# Build type, valid values are debug, dev and prod (production)
# Affects how signing is done and what keys are used and is included
# in the names of resulting images
#  BUILD_TYPE="prod" : The firmware is signed with production keys and no development tools enabled.
#  BUILD_TYPE="debug": The firmware is signed with debug keys and no development tools enabled.
#  BUILD_TYPE="dev": The firmware includes debug tools enabled for the development and signed with debug keys.
BUILD_TYPE ?= "dev"
```

## meta-bmc-n/conf/machine/gb200nvl-scm-n.conf
```bitbake
KMACHINE = "nuvoton"
KERNEL_DEVICETREE = "nuvoton/npcm-bmc-nvidia-gb200nvl-scm.dtb"

UBOOT_MACHINE = "arbel_evb_defconfig"
UBOOT_DEVICETREE = "nuvoton-npcm845-gb200nvl-scm"

IGPS_MACHINE = "EB"
DEVICE_GEN = "A1"

require conf/machine/include/npcm8xx.inc

# Manipulate the DISTRO_NAME variable string for our needs
DISTRO_NAME:remove = "Phosphor"
DISTRO_NAME:remove = "OpenBMC"
DISTRO_NAME:remove = "(Phosphor"
DISTRO_NAME:prepend = "NVIDIA Host BMC (OpenBMC "

UBOOT_MKIMAGE:append:npcm8xx = " -E -B 8"
SECURED_IMAGE = "True"
TIP_IMAGE = "True"

FLASH_SIZE = "65536"
FLASH_UBOOT_OFFSET:flash-65536 = "0"
FLASH_UBOOT_ENV_OFFSET:flash-65536 = "1920"
FLASH_KERNEL_OFFSET:flash-65536 = "2048"
FLASH_ROFS_OFFSET:flash-65536 = "10240"
FLASH_RWFS_OFFSET:flash-65536 = "65536"

SERIAL_CONSOLES = "115200;ttyS0"

VIRTUAL-RUNTIME_obmc-inventory-manager = "entity-manager"
#VIRTUAL-RUNTIME_obmc-inventory-manager = "nvidia-gpumgr"
PREFERRED_PROVIDER_virtual/obmc-inventory-data = "entity-manager"
#PREFERRED_PROVIDER_virtual/obmc-inventory-data = "nvidia-gpumgr"
PREFERRED_PROVIDER_virtual/phosphor-led-manager-config-native = "led-manager-config-native"
PREFERRED_PROVIDER_virtual/obmc-host-ipmi-hw = "phosphor-ipmi-ssif"

PREFERRED_VERSION_u-boot-nuvoton ??= "v2023.10+git"
PREFERRED_VERSION_u-boot-fw-utils-nuvoton ??= "v2023.10+git"

# Install Kernel modules
MACHINE_EXTRA_RRECOMMENDS = "kernel-modules"

# Remove default OpenBMC features we don't need
DISTRO_FEATURES:remove = "avahi"
DISTRO_FEATURES:remove = "otp-provisioning"
IMAGE_FEATURES:remove = "obmc-phosphor-power"
IMAGE_FEATURES:remove = "phosphor-snmp"

DISTRO_FEATURES:append = " erotless-bmc"
# UUID for MTD Updater
BMC_UUID ?= "678aac1134244bcc8a750bb622a3cfeb"

IMAGE_INSTALL:append = " mmc-utils systemd-analyze usbutils"

# this is needed by emmc, avoid removing it.
BAD_RECOMMENDATIONS:remove = "e2fsprogs-e2fsck"

# Build type, valid values are debug, dev and prod (production)
# Affects how signing is done and what keys are used and is included
# in the names of resulting images
#  BUILD_TYPE="prod" : The firmware is signed with production keys and no development tools enabled.
#  BUILD_TYPE="debug": The firmware is signed with debug keys and no development tools enabled.
#  BUILD_TYPE="dev": The firmware includes debug tools enabled for the development and signed with debug keys.
BUILD_TYPE ?= "dev"
```

## meta-hmc-n/conf/layer.conf
```bitbake
# We have a conf and classes directory, add to BBPATH
BBPATH .= ":${LAYERDIR}"

# We have recipes-* directories, add to BBFILES
BBFILES += "${LAYERDIR}/recipes-*/*/*.bb \
            ${LAYERDIR}/recipes-*/*/*.bbappend \
            ${LAYERDIR}/recipes-*/*/*/*.bbappend \
	   "

BBFILE_COLLECTIONS += "nvidia-gb200nvl-bmc-n-layer"
BBFILE_PATTERN_nvidia-gb200nvl-bmc-n-layer = "^${LAYERDIR}/"

LAYERSERIES_COMPAT_nvidia-gb200nvl-bmc-n-layer = "nanbield scarthgap"

# Ignore bbappend related to ASPEED in meta-bmc-n
BBMASK += ".*aspeed.*\.bbappend"
```
